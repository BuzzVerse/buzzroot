## configs/buzzverse_defconfig
```kconfig
BR2_arm=y
BR2_cortex_a8=y
BR2_TOOLCHAIN_EXTERNAL=y
BR2_TARGET_GENERIC_HOSTNAME="beeglebone"
BR2_TARGET_GENERIC_ISSUE="Pszczolem!"
BR2_TARGET_GENERIC_ROOT_PASSWD="iamroot"
BR2_SYSTEM_BIN_SH_BASH=y
BR2_LINUX_KERNEL=y
BR2_LINUX_KERNEL_DEFCONFIG="omap2plus"
BR2_LINUX_KERNEL_DTS_SUPPORT=y
BR2_LINUX_KERNEL_USE_CUSTOM_DTS=y
# doesn't work on this version works on 2022.11
# doesn't boot with this dts stops on [    2.288984] mmcblk1rpmb: mmc1:0001 M62704 512 KiB, chardev (250:0)
# it needs the dts files in output/build/linux-x.x.x/arch/arm/boot/dts/
# there are so many of layers of includes that copying doesn't work
BR2_LINUX_KERNEL_CUSTOM_DTS_PATH="board/buzzverse/dts/am335x-boneblack-buzz.dts"
BR2_LINUX_KERNEL_DTB_OVERLAY_SUPPORT=y
BR2_LINUX_KERNEL_NEEDS_HOST_OPENSSL=y
BR2_PACKAGE_LINUX_TOOLS_GPIO=y
BR2_PACKAGE_BUSYBOX_SHOW_OTHERS=y
BR2_PACKAGE_SPI_TOOLS=y
BR2_PACKAGE_OPENSSH=y
BR2_PACKAGE_NEOFETCH=y
BR2_PACKAGE_SUDO=y
BR2_PACKAGE_TMUX=y
BR2_PACKAGE_WHICH=y
BR2_PACKAGE_ZOXIDE=y
BR2_PACKAGE_NANO=y
BR2_PACKAGE_VIM=y
BR2_TARGET_UBOOT=y
BR2_TARGET_UBOOT_BOARD_DEFCONFIG="am335x_evm"
# BR2_TARGET_UBOOT_FORMAT_BIN is not set
BR2_TARGET_UBOOT_FORMAT_IMG=y
BR2_TARGET_UBOOT_SPL=y
BR2_TARGET_UBOOT_SPL_NAME="MLO"
```
